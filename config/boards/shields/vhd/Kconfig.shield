## config/boards/shields/vhd/Kconfig.shield
```kconfig
# Copyright (c) 2020 The ZMK Contributors
# SPDX-License-Identifier: MIT

config SHIELD_vhd_LEFT
    def_bool $(shields_list_contains,vhd_left)

config SHIELD_vhd_RIGHT
    def_bool $(shields_list_contains,vhd_right)
```
